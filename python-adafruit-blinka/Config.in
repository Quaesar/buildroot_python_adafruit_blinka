## python-adafruit-blinka/Config.in
```kconfig
config BR2_PACKAGE_PYTHON_ADAFRUIT_BLINKA
	bool "python-adafruit-blinka"
	select BR2_PACKAGE_PYTHON
	help
	  Adafruit-Blinka Library

	  http://pypi.python.org/pypi/Adafruit-Blinka
```
